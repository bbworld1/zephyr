## drivers/sensor/ak8975/Kconfig
```kconfig
# AK8975 magnetometer configuration options

# Copyright (c) 2016 Intel Corporation
# SPDX-License-Identifier: Apache-2.0

config AK8975
	bool "AK8975 Magnetometer"
	depends on I2C
	help
	  Enable driver for AK8975 magnetometer.

config AK8975_DOUBLE
    bool "AK8963 compatibility mode (2x precision scaling)"
```
